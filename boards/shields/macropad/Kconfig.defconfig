## boards/shields/macropad/Kconfig.defconfig
```kconfig
menu "Macropad Default Configuration"

config ZMK_BATTERY
    bool "Enable battery support"
    default y

config DISPLAY
    bool "Enable display support"
    default y

config SSD1306
    bool "Enable SSD1306 OLED support"
    default y

config ZMK_ENCODERS
    bool "Enable rotary encoder support"
    default y

config USB_DEVICE_STACK
    bool "Enable USB device stack"
    default y

config LOG
    bool "Enable logging"
    default y

config LOG_DEFAULT_LEVEL
    int "Default log level"
    default 3

endmenu
```

## boards/shields/macropad/Kconfig.shield
```kconfig
menu "Macropad Shield"

config MACROPAD
    bool "4-key macropad shield"
    default y
    help
      Enable support for the 4-key macropad shield with OLED and encoder.

source "boards/shields/macropad/macropad.overlay"

endmenu
```
